/********************************* Shenzhen Aerospace Electronics Co., Ltd *******************************
 * Experiment Name: Automatic Melody Experiment
 * Experiment Description: Automatically play melodies
 * Experiment Platform: Aerospace 51 microcontroller development board
 * Connection Method: CN16-CN7, BEEP1-P06
 * Note: N/A
 * Author: Aerospace Electronics Product Development Department    QQ: 1909197536
 * Store: http://shop120013844.taobao.com/
 ****************************************************************************************/

#include <reg52.h>
#include <intrins.h>

#define FOSC 11059200L // Crystal oscillator setting, default is 11.0592M Hz
// #define FOSC 12000000L // Crystal oscillator setting, using 12M Hz
// #define FOSC 24000000L // Crystal oscillator setting, using 24M Hz
#define T10MS (65536 - FOSC / 12 / 100) // 10ms Timer

// IO interface definition
sbit speak_IO = P0 ^ 6; // Speaker interface

// Global variables
unsigned char count;

// Melody data
unsigned char code SONG[] = {
	// Melody data here

	0x26,0x20,0x20,0x20,0x20,0x20,0x26,0x10,0x20,0x10,0x20,0x80,
	0x26,0x20,0x30,0x20,0x30,0x20,0x39,0x10,0x30,0x10,0x30,0x80,
	0x26,0x20,0x20,0x20,0x20,0x20,0x1c,0x20,0x20,0x80,0x2b,0x20,
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	0x20,0x10,0x2b,0x10,0x26,0x30,0x30,0x80,0x00,
	//Do not pick the wildflowers by the roadside
	0x30,0x1C,0x10,0x20,0x40,0x1C,0x10,0x18,0x10,0x20,0x10,0x1C,
	0x10,0x18,0x40,0x1C,0x20,0x20,0x20,0x1C,0x20,0x18,0x20,0x20,
	0x80,0xFF,0x20,0x30,0x1C,0x10,0x18,0x20,0x15,0x20,0x1C,0x20,
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	0x80,0x00,
};

/*******************************************************************************
 * Function Name: Delayms
 * Function Description: Delay in milliseconds
 * Input: ms - delay time in milliseconds
 * Output: None
 *******************************************************************************/
void Delayms(unsigned int ms)
{
	unsigned int i, j;
	for (i = 0; i < ms; i++)
#if FOSC == 11059200L
		for (j = 0; j < 114; j++)
			;
#elif FOSC == 12000000L
		for (j = 0; j < 123; j++)
			;
#elif FOSC == 24000000L
		for (j = 0; j < 249; j++)
			;
#else
		for (j = 0; j < 114; j++)
			;
#endif
}

/*******************************************************************************
 * Function Name: Delayus
 * Function Description: Delay in microseconds
 * Input: us - delay time in microseconds
 * Output: None
 *******************************************************************************/
void Delayus(unsigned int us)
{
	unsigned int i, j;
	for (i = 0; i < us; i++)
		for (j = 0; j < 3; j++)
			;
}

/*******************************************************************************
 * Function Name: Time0Init
 * Function Description: Initialize Timer 0
 * Input: None
 * Output: None
 *******************************************************************************/
void Time0Init()
{
	TMOD = 0x01;	  // Set timer mode
	IE = 0x82;		  // Enable timer interrupt
	TH0 = T10MS >> 8; // Set reload value for timer (10ms)
	TL0 = T10MS;
}

/*******************************************************************************
 * Function Name: Time0Int
 * Function Description: Timer 0 interrupt handler
 * Input: None
 * Output: None
 *******************************************************************************/
void Time0Int() interrupt 1
{
	TH0 = T10MS >> 8; // Set reload value for timer (10ms)
	TL0 = T10MS;
	count++; // Increment count
}

/*******************************************************************************
 * Function Name: PlaySong
 * Function Description: Play a melody
 * Input: i - index of the melody to play
 * Output: None
 *******************************************************************************/
void PlaySong(unsigned char i)
{
	unsigned char Temp1, Temp2;
	unsigned int Addr;
	count = 0; // Reset count
	Addr = i * 217;
	while (1)
	{
		Temp1 = SONG[Addr++]; // Get frequency
		if (Temp1 == 0xFF)	  // Stop bit
		{
			TR0 = 0;
			Delayus(100);
		}
		else if (Temp1 == 0x00) // End of melody
		{
			return;
		}
		else
		{
			Temp2 = SONG[Addr++]; // Get duration
			TR0 = 1;
			while (1)
			{
				speak_IO = ~speak_IO;
				Delayus(Temp1);
				if (Temp2 == count) // End of a note
				{
					count = 0;
					break;
				}
			}
		}
	}
}

/*******************************************************************************
 * Function Name: main
 * Function Description: Main function
 * Input: None
 * Output: None
 *******************************************************************************/
void main()
{
	Time0Init(); // Initialize Timer 0

	while (1)
	{
		PlaySong(0); // Play the first melody
		Delayms(1000);
		PlaySong(1); // Play the second melody
	}
}
